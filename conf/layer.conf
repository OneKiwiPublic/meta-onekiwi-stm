## conf/layer.conf
```bitbake
# We have a conf and classes directory, add to BBPATH
BBPATH .= ":${LAYERDIR}"

# We have recipes-* directories, add to BBFILES
BBFILES += "${LAYERDIR}/recipes-*/*/*.bb \
            ${LAYERDIR}/recipes-*/*/*.bbappend"

BBFILE_COLLECTIONS += "meta-onekiwi-stm"
BBFILE_PATTERN_meta-onekiwi-stm = "^${LAYERDIR}/"
BBFILE_PRIORITY_meta-onekiwi-stm = "6"

LAYERDEPENDS_meta-onekiwi-stm = "core"
LAYERSERIES_COMPAT_meta-onekiwi-stm = "mickledore"
```
